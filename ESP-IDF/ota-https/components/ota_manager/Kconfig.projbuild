## ESP-IDF/ota-https/components/ota_manager/Kconfig.projbuild
```kconfig
menu "OTA Manager"

    config OTA_MANAGER_FIRMWARE_URL
        string "URL para atualização de firmware"
        default "https://example.com/firmware.bin"
        help
            URL HTTPS onde está hospedado o firmware .bin.

    config OTA_MANAGER_SKIP_COMMON_NAME_CHECK
        bool "Ignorar verificação do CN do certificado"
        default n
        help
            Ignora a validação do Common Name do certificado.

            ATENCAO:
            Reduz a segurança da conexão TLS.
            Não recomendado para produção.

    config OTA_MANAGER_SKIP_VERSION_CHECK
        bool "Ignorar verificação de versão"
        default n
        help
            Permite instalar firmware com a mesma versão atual.

    config OTA_MANAGER_VALIDATION_TIME_SEC
        int "Tempo de auto-teste antes de validar o firmware (s)"
        default 10
        range 1 300
        depends on BOOTLOADER_APP_ROLLBACK_ENABLE
        help
            Tempo, em segundos, que o novo firmware aguarda após o boot
            antes de ser marcado como válido.

            Se o dispositivo reiniciar (crash, watchdog, brownout, etc.)
            antes desse tempo, a confirmação nunca acontece e o
            bootloader faz rollback automático para a versão anterior
            no próximo boot.

    config OTA_MANAGER_RECV_TIMEOUT
        int "Timeout de recepção OTA (ms)"
        default 5000
        range 1000 120000
        help
            Tempo máximo de espera durante operações de rede.

    config OTA_MANAGER_RX_BUFFER_SIZE
        int "Tamanho do buffer HTTP RX"
        default 8192
        range 1024 32768

    config OTA_MANAGER_TX_BUFFER_SIZE
        int "Tamanho do buffer HTTP TX"
        default 2048
        range 512 16384

    config OTA_MANAGER_ENABLE_PARTIAL_HTTP_DOWNLOAD
        bool "Habilitar download HTTP parcial"
        default n
        help
            Habilita download utilizando múltiplas requisições HTTP.

    config OTA_MANAGER_HTTP_REQUEST_SIZE
        int "Tamanho máximo de cada requisição HTTP"
        default 4096
        range 1024 16384
        depends on OTA_MANAGER_ENABLE_PARTIAL_HTTP_DOWNLOAD

endmenu
```

## ESP-IDF/ota-https/main/Kconfig.projbuild
```kconfig
menu "Configurações do Wi-Fi Manager"

    config ESP_WIFI_SSID
        string "SSID do Access Point"
        default "ESPIDF"
        help
            Define o SSID (nome da rede) do Access Point Wi-Fi que será criado pelo ESP32.

    config ESP_WIFI_PASSWORD
        string "Senha do Access Point"
        default "12345678"
        help
            Define a senha do Access Point Wi-Fi. 
            Se a senha for deixada em branco (""), a rede será aberta (sem senha).

    config ESP_WIFI_CHANNEL
        int "Canal de frequência do AP"
        range 1 13
        default 1
        help
            Define o canal de frequência Wi-Fi que o Access Point usará. 
            O canal 1, 6 ou 11 são os mais comuns para redes 2.4 GHz.

    config MAX_STA_CONN
        int "Número máximo de conexões simultâneas no AP"
        range 1 10
        default 2
        help
            Define o número máximo de dispositivos (estações) que podem 
            se conectar ao seu Access Point simultaneamente.

    config ESP_MAXIMUM_RETRY
        int "Tentativas de conexão (Station)"
        default 10
        help
            Define o número máximo de tentativas de conexão ao roteador 
            antes do ESP32 desistir e tomar uma ação de falha.

    config NUMERO_MAX_TENTATIVAS
        int "Ação após falha (0 = Reiniciar, 1 = Modo AP)"
        range 0 1
        default 0
        help
            Ação tomada caso o limite de tentativas de conexão seja atingido:
            1 -> Habilita a entrada no modo Access Point (AP).
            0 -> O ESP32 apenas reinicia.

    choice ESP_WIFI_SAE_MODE
        prompt "Seleção do modo WPA3 SAE"
        default ESP_WPA3_SAE_PWE_BOTH
        help
            Selecione o modo de segurança SAE (Hunt and Peck, H2E ou ambos).
            
        config ESP_WPA3_SAE_PWE_HUNT_AND_PECK
            bool "HUNT AND PECK"
        config ESP_WPA3_SAE_PWE_HASH_TO_ELEMENT
            bool "H2E"
        config ESP_WPA3_SAE_PWE_BOTH
            bool "AMBOS (BOTH)"
    endchoice

    config ESP_WIFI_PW_ID
        string "Identificador de Senha (SAE H2E)"
        depends on ESP_WPA3_SAE_PWE_HASH_TO_ELEMENT || ESP_WPA3_SAE_PWE_BOTH
        default ""
        help
            Identificador de senha usado especificamente para segurança SAE H2E.

    choice ESP_WIFI_SCAN_AUTH_MODE_THRESHOLD
        prompt "Autenticação mínima aceita no Scan"
        default ESP_WIFI_AUTH_WPA2_PSK
        help
            O nível de segurança mais fraco que o ESP32 aceitará ao buscar redes.
            O padrão é WPA2_PSK. Selecione WEP ou WPA_PSK caso o roteador local
            opere nesses modos mais antigos.

        config ESP_WIFI_AUTH_OPEN
            bool "OPEN (Aberta)"
        config ESP_WIFI_AUTH_WEP
            bool "WEP"
        config ESP_WIFI_AUTH_WPA_PSK
            bool "WPA PSK"
        config ESP_WIFI_AUTH_WPA2_PSK
            bool "WPA2 PSK"
        config ESP_WIFI_AUTH_WPA_WPA2_PSK
            bool "WPA/WPA2 PSK"
        config ESP_WIFI_AUTH_WPA3_PSK
            bool "WPA3 PSK"
        config ESP_WIFI_AUTH_WPA2_WPA3_PSK
            bool "WPA2/WPA3 PSK"
        config ESP_WIFI_AUTH_WAPI_PSK
            bool "WAPI PSK"
    endchoice

endmenu
```
